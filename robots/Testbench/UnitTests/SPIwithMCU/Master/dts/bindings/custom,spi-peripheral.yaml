## robots/Testbench/UnitTests/SPIwithMCU/Master/dts/bindings/custom,spi-peripheral.yaml
```yaml
description: Custom SPI peripheral (second STM32)
compatible: "custom,spi-peripheral"
include: spi-device.yaml
```
